## board/chargepoint/dcc/Kconfig
```kconfig
if TARGET_AM335X_DCC

config SYS_BOARD
	default "dcc"

config SYS_VENDOR
	default "chargepoint"

config SYS_SOC
	default "am33xx"

config SYS_CONFIG_NAME
	default "am335x_dcc"

endif
```

## configs/am335x_dcc_defconfig
```kconfig
CONFIG_ARM=y
CONFIG_TARGET_AM335X_DCC=y
CONFIG_SPL_STACK_R_ADDR=0x82000000
CONFIG_SPL=y
CONFIG_SPL_STACK_R=y
CONFIG_SPL_BOARD_INIT=y
CONFIG_SPL_ETH_SUPPORT=y
CONFIG_SPL_NET_SUPPORT=y
CONFIG_ETH_SUPPORT=y
CONFIG_SPL_LIBGENERIC_SUPPORT=y
CONFIG_SPL_LIBCOMMON_SUPPORT=y
CONFIG_SPL_BUILD=y
CONFIG_AUTOBOOT_KEYED=y
CONFIG_AUTOBOOT_PROMPT="Press SPACE to abort autoboot in %d seconds\n"
CONFIG_AUTOBOOT_DELAY_STR="d"
CONFIG_AUTOBOOT_STOP_STR=" "
# CONFIG_CMD_IMLS is not set
# CONFIG_CMD_FLASH is not set
CONFIG_CMD_GPIO=y
# CONFIG_CMD_SETEXPR is not set
CONFIG_SYS_NS16550=y

# CONFIG_DFU_TFTP=y
# CONFIG_SYS_NS16550_COM2=y
# CONFIG_SYS_NS16550_COM3=y
```
